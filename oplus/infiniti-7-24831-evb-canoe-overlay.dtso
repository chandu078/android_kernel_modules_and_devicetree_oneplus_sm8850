// SPDX-License-Identifier: BSD-3-Clause
/dts-v1/;
/plugin/;

#include "infiniti-24831-canoe-overlay.dtso"
#include "infiniti-subsystems.dtsi"
#include "../qcom/audio/oplus/infiniti-audio-gpio-T0.dtsi"

/ {
	oplus,project-id = <24831>;
	oplus,hw-id = <OPLUS_EVB1 OPLUS_EVB2 OPLUS_EVB3>;
};
