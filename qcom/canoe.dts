// SPDX-License-Identifier: BSD-3-Clause
/*
 * Copyright (c) 2024 Qualcomm Innovation Center, Inc. All rights reserved.
 */

/dts-v1/;

#include "canoe.dtsi"

/ {
	model = "Qualcomm Technologies, Inc. Canoe SoC";
	compatible = "qcom,canoe";
	qcom,board-id = <0 0>;
};

#include "canoe-subsystems-common.dtsi"
#include "canoe-subsystems-v1.dtsi"
#include "canoe-subsystems-modem.dtsi"
