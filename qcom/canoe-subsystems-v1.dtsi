// SPDX-License-Identifier: BSD-3-Clause
/* Subsystem includes for the Canoe v1 configuration. */

#include <dt-bindings/clock/qcom,gcc-canoe.h>
#include <dt-bindings/clock/qcom,camcc-canoe.h>
#include <dt-bindings/interconnect/qcom,canoe.h>
#include <dt-bindings/interrupt-controller/arm-gic.h>
#include <dt-bindings/regulator/qcom,rpmh-regulator-levels.h>

#include "camera/canoe-camera.dtsi"

#include "dsp/canoe/canoe-dsp.dtsi"

#include <dt-bindings/clock/qcom,aop-qmp.h>
#include <dt-bindings/clock/qcom,gpucc-canoe.h>
#include <dt-bindings/clock/qcom,gxclkctl-canoe.h>
#include <dt-bindings/clock/qcom,rpmh.h>

#include "graphics/gpu/canoe-gpu.dtsi"
#include "graphics/gpu/canoe-gpu-pwrlevels.dtsi"

#include <dt-bindings/clock/qcom,videocc-canoe.h>
#include "video/canoe-vidc.dtsi"

#include <dt-bindings/clock/qcom,evacc-canoe.h>
#include <dt-bindings/clock/qcom,dispcc-canoe.h>
#include "mmrm/canoe/canoe-mmrm-test.dtsi"
