// SPDX-License-Identifier: BSD-3-Clause
/* Subsystem includes for the Canoe v2 configuration. */

#include <dt-bindings/clock/qcom,gcc-canoe.h>
#include <dt-bindings/clock/qcom,camcc-canoe.h>
#include <dt-bindings/interconnect/qcom,canoe.h>
#include <dt-bindings/interrupt-controller/arm-gic.h>
#include <dt-bindings/regulator/qcom,rpmh-regulator-levels.h>

#include "camera/canoe-camera-v2.dtsi"

#include "dsp/canoe/canoe-dsp_v2.dtsi"

#include <dt-bindings/clock/qcom,aop-qmp.h>
#include <dt-bindings/clock/qcom,gpucc-canoe.h>
#include <dt-bindings/clock/qcom,gxclkctl-canoe.h>
#include <dt-bindings/clock/qcom,rpmh.h>

#include "graphics/gpu/canoe-v2-gpu.dtsi"
#include "graphics/gpu/canoe-v2-gpu-pwrlevels.dtsi"

#include <dt-bindings/clock/qcom,videocc-canoe.h>
#include "video/canoe-vidc-v2.dtsi"
